## testbed/y2/buildroot/package/y2-fbtool/Config.in
```kconfig
config BR2_PACKAGE_Y2_FBTOOL
	bool "y2-fbtool"
	help
	  Tiny framebuffer test tool for the Y2 rescue initramfs
	  (info, colour bars, fill, progress row). No font.
```
